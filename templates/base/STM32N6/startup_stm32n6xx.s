/* startup_stm32n6xx.s — Cortex-M55 startup for STM32N657xx
 * Generated by STM32 AI Deployer
 */

.syntax unified
.thumb

.global g_pfnVectors
.global Default_Handler

/* Linker-defined symbols */
.word _sidata
.word _sdata
.word _edata
.word _sbss
.word _ebss

/* ── Reset handler ─────────────────────────────────────────────────────────── */
.section .text.Reset_Handler
.weak   Reset_Handler
.type   Reset_Handler, %function
Reset_Handler:
  ldr   r0, =_estack
  mov   sp, r0

  /* Call SystemInit if present */
  bl    SystemInit

  /* Copy .data from FLASH to RAM */
  ldr   r0, =_sdata
  ldr   r1, =_edata
  ldr   r2, =_sidata
  movs  r3, #0
  b     LoopCopyData
CopyData:
  ldr   r4, [r2, r3]
  str   r4, [r0, r3]
  adds  r3, r3, #4
LoopCopyData:
  adds  r4, r0, r3
  cmp   r4, r1
  bcc   CopyData

  /* Zero-fill .bss */
  ldr   r2, =_sbss
  ldr   r4, =_ebss
  movs  r3, #0
  b     LoopFillZerobss
FillZero:
  str   r3, [r2], #4
LoopFillZerobss:
  cmp   r2, r4
  bcc   FillZero

  /* Call C++ constructors then main */
  bl    __libc_init_array
  bl    main

LoopForever:
  b     LoopForever

.size Reset_Handler, .-Reset_Handler

/* ── Default handler ───────────────────────────────────────────────────────── */
.section .text.Default_Handler,"ax",%progbits
Default_Handler:
Infinite_Loop:
  b     Infinite_Loop
.size Default_Handler, .-Default_Handler

/* ── Vector table ──────────────────────────────────────────────────────────── */
.section .isr_vector,"a",%progbits
.type   g_pfnVectors, %object

g_pfnVectors:
  .word _estack
  .word Reset_Handler
  .word NMI_Handler
  .word HardFault_Handler
  .word MemManage_Handler
  .word BusFault_Handler
  .word UsageFault_Handler
  .word 0
  .word 0
  .word 0
  .word 0
  .word SVC_Handler
  .word DebugMon_Handler
  .word 0
  .word PendSV_Handler
  .word SysTick_Handler

  /* External interrupts (STM32N657xx — first 16 relevant entries) */
  .word Default_Handler   /* 0:  WWDG         */
  .word Default_Handler   /* 1:  PVD/AVD      */
  .word Default_Handler   /* 2:  RTC/TAMP     */
  .word Default_Handler   /* 3:  RTC_WKUP     */
  .word Default_Handler   /* 4:  FLASH        */
  .word Default_Handler   /* 5:  RCC          */
  .word Default_Handler   /* 6:  EXTI0        */
  .word Default_Handler   /* 7:  EXTI1        */
  .word Default_Handler   /* 8:  EXTI2        */
  .word Default_Handler   /* 9:  EXTI3        */
  .word Default_Handler   /* 10: EXTI4        */
  .word Default_Handler   /* 11: DMA1_CH0     */
  .word Default_Handler   /* 12: DMA1_CH1     */
  .word Default_Handler   /* 13: DMA1_CH2     */
  .word Default_Handler   /* 14: DMA1_CH3     */
  .word Default_Handler   /* 15: DMA1_CH4     */
  .word Default_Handler   /* 16: DMA1_CH5     */
  .word Default_Handler   /* 17: DMA1_CH6     */
  .word Default_Handler   /* 18: DMA1_CH7     */
  .word Default_Handler   /* 19: ADC1         */
  .word Default_Handler   /* 20: ADC2         */
  .word Default_Handler   /* 21: reserved     */
  .word Default_Handler   /* 22: reserved     */
  .word Default_Handler   /* 23: reserved     */
  .word Default_Handler   /* 24: EXTI5        */
  .word Default_Handler   /* 25: TIM1_BRK     */
  .word Default_Handler   /* 26: TIM1_UP      */
  .word Default_Handler   /* 27: TIM1_TRG_COM */
  .word Default_Handler   /* 28: TIM1_CC      */
  .word Default_Handler   /* 29: TIM2         */
  .word Default_Handler   /* 30: TIM3         */
  .word Default_Handler   /* 31: TIM4         */
  .word Default_Handler   /* 32: I2C1_EV      */
  .word Default_Handler   /* 33: I2C1_ER      */
  .word Default_Handler   /* 34: I2C2_EV      */
  .word Default_Handler   /* 35: I2C2_ER      */
  .word Default_Handler   /* 36: SPI1         */
  .word Default_Handler   /* 37: SPI2         */
  .word USART1_IRQHandler /* 38: USART1       */
  .word Default_Handler   /* 39: USART2       */
  .word Default_Handler   /* 40: USART3       */
  .word Default_Handler   /* 41: EXTI10       */
  .word Default_Handler   /* 42: RTC_ALARM    */

.size g_pfnVectors, .-g_pfnVectors

/* ── Weak aliases for all handlers ─────────────────────────────────────────── */
.weak NMI_Handler
.thumb_set NMI_Handler, Default_Handler

.weak HardFault_Handler
.thumb_set HardFault_Handler, Default_Handler

.weak MemManage_Handler
.thumb_set MemManage_Handler, Default_Handler

.weak BusFault_Handler
.thumb_set BusFault_Handler, Default_Handler

.weak UsageFault_Handler
.thumb_set UsageFault_Handler, Default_Handler

.weak SVC_Handler
.thumb_set SVC_Handler, Default_Handler

.weak DebugMon_Handler
.thumb_set DebugMon_Handler, Default_Handler

.weak PendSV_Handler
.thumb_set PendSV_Handler, Default_Handler

.weak SysTick_Handler
.thumb_set SysTick_Handler, Default_Handler

.weak USART1_IRQHandler
.thumb_set USART1_IRQHandler, Default_Handler
